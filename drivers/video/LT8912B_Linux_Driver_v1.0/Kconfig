## drivers/video/LT8912B_Linux_Driver_v1.0/Kconfig
```kconfig
config LT8912B
	tristate "LT8912B Driver"
	default m
	help
	  Control LT8912B Chip
	  Select m:build as a separate module;
	  Select y:Build into the kernel
	  Select n:Not build 
```
